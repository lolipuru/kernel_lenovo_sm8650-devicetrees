/dts-v1/;
/plugin/;

#include <dt-bindings/clock/qcom,gcc-pineapple.h>
#include <dt-bindings/clock/qcom,camcc-pineapple.h>
#include <dt-bindings/interconnect/qcom,pineapple.h>
#include <dt-bindings/interrupt-controller/arm-gic.h>
#include <dt-bindings/regulator/qcom,rpmh-regulator-levels.h>

#include "kirby-camera-sensor-qrd.dtsi"

/ {
	model = "Qualcomm Technologies, Inc. Kirby QRD";
	compatible = "qcom,kirby-qrd", "qcom,kirby", "qcom,qrd";
	qcom,msm-id = <557 0x20000>, <557 0x10000>, <577 0x20000>, <577 0x10000>;
	qcom,board-id = <0x3000B 0>;
};

